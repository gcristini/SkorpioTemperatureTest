;
; File Name: cyfitterrv.inc
; 
; PSoC Creator  4.3
;
; Description:
; 
;
;-------------------------------------------------------------------------------
; Copyright (c) 2007-2019 Cypress Semiconductor.  All rights reserved.
; You may use this file only in accordance with the license, terms, conditions, 
; disclaimers, and limitations in the end user license agreement accompanying 
; the software package with which this file was provided.
;-------------------------------------------------------------------------------

    IF :LNOT::DEF:INCLUDED_CYFITTERRV_INC
INCLUDED_CYFITTERRV_INC EQU 1
    GET cydevicerv_trm.inc

; PGA
PGA_cy_psoc4_abuf__COMP_STAT EQU CYREG_CTB0_COMP_STAT
PGA_cy_psoc4_abuf__COMP_STAT_SHIFT EQU 0
PGA_cy_psoc4_abuf__CTB_CTB_CTRL EQU CYREG_CTB0_CTB_CTRL
PGA_cy_psoc4_abuf__INTR EQU CYREG_CTB0_INTR
PGA_cy_psoc4_abuf__INTR_MASK EQU CYREG_CTB0_INTR_MASK
PGA_cy_psoc4_abuf__INTR_MASK_SHIFT EQU 0
PGA_cy_psoc4_abuf__INTR_MASKED EQU CYREG_CTB0_INTR_MASKED
PGA_cy_psoc4_abuf__INTR_MASKED_SHIFT EQU 0
PGA_cy_psoc4_abuf__INTR_SET EQU CYREG_CTB0_INTR_SET
PGA_cy_psoc4_abuf__INTR_SET_SHIFT EQU 0
PGA_cy_psoc4_abuf__INTR_SHIFT EQU 0
PGA_cy_psoc4_abuf__OA_COMP_TRIM EQU CYREG_CTB0_OA0_COMP_TRIM
PGA_cy_psoc4_abuf__OA_NUMBER EQU 0
PGA_cy_psoc4_abuf__OA_OFFSET_TRIM EQU CYREG_CTB0_OA0_OFFSET_TRIM
PGA_cy_psoc4_abuf__OA_RES_CTRL EQU CYREG_CTB0_OA_RES0_CTRL
PGA_cy_psoc4_abuf__OA_SLOPE_OFFSET_TRIM EQU CYREG_CTB0_OA0_SLOPE_OFFSET_TRIM
PGA_cy_psoc4_abuf__OA_SW EQU CYREG_CTB0_OA0_SW
PGA_cy_psoc4_abuf__OA_SW_CLEAR EQU CYREG_CTB0_OA0_SW_CLEAR

; UART_PC
UART_PC_rx__0__DR EQU CYREG_GPIO_PRT0_DR
UART_PC_rx__0__DR_CLR EQU CYREG_GPIO_PRT0_DR_CLR
UART_PC_rx__0__DR_INV EQU CYREG_GPIO_PRT0_DR_INV
UART_PC_rx__0__DR_SET EQU CYREG_GPIO_PRT0_DR_SET
UART_PC_rx__0__HSIOM EQU CYREG_HSIOM_PORT_SEL0
UART_PC_rx__0__HSIOM_GPIO EQU 0
UART_PC_rx__0__HSIOM_I2C EQU 14
UART_PC_rx__0__HSIOM_I2C_SCL EQU 14
UART_PC_rx__0__HSIOM_MASK EQU 0x000F0000
UART_PC_rx__0__HSIOM_SHIFT EQU 16
UART_PC_rx__0__HSIOM_SPI EQU 15
UART_PC_rx__0__HSIOM_SPI_MOSI EQU 15
UART_PC_rx__0__HSIOM_UART EQU 9
UART_PC_rx__0__HSIOM_UART_RX EQU 9
UART_PC_rx__0__INTCFG EQU CYREG_GPIO_PRT0_INTR_CFG
UART_PC_rx__0__INTR EQU CYREG_GPIO_PRT0_INTR
UART_PC_rx__0__INTR_CFG EQU CYREG_GPIO_PRT0_INTR_CFG
UART_PC_rx__0__INTSTAT EQU CYREG_GPIO_PRT0_INTR
UART_PC_rx__0__MASK EQU 0x10
UART_PC_rx__0__PC EQU CYREG_GPIO_PRT0_PC
UART_PC_rx__0__PC2 EQU CYREG_GPIO_PRT0_PC2
UART_PC_rx__0__PORT EQU 0
UART_PC_rx__0__PS EQU CYREG_GPIO_PRT0_PS
UART_PC_rx__0__SHIFT EQU 4
UART_PC_rx__DR EQU CYREG_GPIO_PRT0_DR
UART_PC_rx__DR_CLR EQU CYREG_GPIO_PRT0_DR_CLR
UART_PC_rx__DR_INV EQU CYREG_GPIO_PRT0_DR_INV
UART_PC_rx__DR_SET EQU CYREG_GPIO_PRT0_DR_SET
UART_PC_rx__INTCFG EQU CYREG_GPIO_PRT0_INTR_CFG
UART_PC_rx__INTR EQU CYREG_GPIO_PRT0_INTR
UART_PC_rx__INTR_CFG EQU CYREG_GPIO_PRT0_INTR_CFG
UART_PC_rx__INTSTAT EQU CYREG_GPIO_PRT0_INTR
UART_PC_rx__MASK EQU 0x10
UART_PC_rx__PC EQU CYREG_GPIO_PRT0_PC
UART_PC_rx__PC2 EQU CYREG_GPIO_PRT0_PC2
UART_PC_rx__PORT EQU 0
UART_PC_rx__PS EQU CYREG_GPIO_PRT0_PS
UART_PC_rx__SHIFT EQU 4
UART_PC_SCB__CTRL EQU CYREG_SCB1_CTRL
UART_PC_SCB__EZ_DATA0 EQU CYREG_SCB1_EZ_DATA0
UART_PC_SCB__EZ_DATA1 EQU CYREG_SCB1_EZ_DATA1
UART_PC_SCB__EZ_DATA10 EQU CYREG_SCB1_EZ_DATA10
UART_PC_SCB__EZ_DATA11 EQU CYREG_SCB1_EZ_DATA11
UART_PC_SCB__EZ_DATA12 EQU CYREG_SCB1_EZ_DATA12
UART_PC_SCB__EZ_DATA13 EQU CYREG_SCB1_EZ_DATA13
UART_PC_SCB__EZ_DATA14 EQU CYREG_SCB1_EZ_DATA14
UART_PC_SCB__EZ_DATA15 EQU CYREG_SCB1_EZ_DATA15
UART_PC_SCB__EZ_DATA16 EQU CYREG_SCB1_EZ_DATA16
UART_PC_SCB__EZ_DATA17 EQU CYREG_SCB1_EZ_DATA17
UART_PC_SCB__EZ_DATA18 EQU CYREG_SCB1_EZ_DATA18
UART_PC_SCB__EZ_DATA19 EQU CYREG_SCB1_EZ_DATA19
UART_PC_SCB__EZ_DATA2 EQU CYREG_SCB1_EZ_DATA2
UART_PC_SCB__EZ_DATA20 EQU CYREG_SCB1_EZ_DATA20
UART_PC_SCB__EZ_DATA21 EQU CYREG_SCB1_EZ_DATA21
UART_PC_SCB__EZ_DATA22 EQU CYREG_SCB1_EZ_DATA22
UART_PC_SCB__EZ_DATA23 EQU CYREG_SCB1_EZ_DATA23
UART_PC_SCB__EZ_DATA24 EQU CYREG_SCB1_EZ_DATA24
UART_PC_SCB__EZ_DATA25 EQU CYREG_SCB1_EZ_DATA25
UART_PC_SCB__EZ_DATA26 EQU CYREG_SCB1_EZ_DATA26
UART_PC_SCB__EZ_DATA27 EQU CYREG_SCB1_EZ_DATA27
UART_PC_SCB__EZ_DATA28 EQU CYREG_SCB1_EZ_DATA28
UART_PC_SCB__EZ_DATA29 EQU CYREG_SCB1_EZ_DATA29
UART_PC_SCB__EZ_DATA3 EQU CYREG_SCB1_EZ_DATA3
UART_PC_SCB__EZ_DATA30 EQU CYREG_SCB1_EZ_DATA30
UART_PC_SCB__EZ_DATA31 EQU CYREG_SCB1_EZ_DATA31
UART_PC_SCB__EZ_DATA4 EQU CYREG_SCB1_EZ_DATA4
UART_PC_SCB__EZ_DATA5 EQU CYREG_SCB1_EZ_DATA5
UART_PC_SCB__EZ_DATA6 EQU CYREG_SCB1_EZ_DATA6
UART_PC_SCB__EZ_DATA7 EQU CYREG_SCB1_EZ_DATA7
UART_PC_SCB__EZ_DATA8 EQU CYREG_SCB1_EZ_DATA8
UART_PC_SCB__EZ_DATA9 EQU CYREG_SCB1_EZ_DATA9
UART_PC_SCB__I2C_CFG EQU CYREG_SCB1_I2C_CFG
UART_PC_SCB__I2C_CTRL EQU CYREG_SCB1_I2C_CTRL
UART_PC_SCB__I2C_M_CMD EQU CYREG_SCB1_I2C_M_CMD
UART_PC_SCB__I2C_S_CMD EQU CYREG_SCB1_I2C_S_CMD
UART_PC_SCB__I2C_STATUS EQU CYREG_SCB1_I2C_STATUS
UART_PC_SCB__INTR_CAUSE EQU CYREG_SCB1_INTR_CAUSE
UART_PC_SCB__INTR_I2C_EC EQU CYREG_SCB1_INTR_I2C_EC
UART_PC_SCB__INTR_I2C_EC_MASK EQU CYREG_SCB1_INTR_I2C_EC_MASK
UART_PC_SCB__INTR_I2C_EC_MASKED EQU CYREG_SCB1_INTR_I2C_EC_MASKED
UART_PC_SCB__INTR_M EQU CYREG_SCB1_INTR_M
UART_PC_SCB__INTR_M_MASK EQU CYREG_SCB1_INTR_M_MASK
UART_PC_SCB__INTR_M_MASKED EQU CYREG_SCB1_INTR_M_MASKED
UART_PC_SCB__INTR_M_SET EQU CYREG_SCB1_INTR_M_SET
UART_PC_SCB__INTR_RX EQU CYREG_SCB1_INTR_RX
UART_PC_SCB__INTR_RX_MASK EQU CYREG_SCB1_INTR_RX_MASK
UART_PC_SCB__INTR_RX_MASKED EQU CYREG_SCB1_INTR_RX_MASKED
UART_PC_SCB__INTR_RX_SET EQU CYREG_SCB1_INTR_RX_SET
UART_PC_SCB__INTR_S EQU CYREG_SCB1_INTR_S
UART_PC_SCB__INTR_S_MASK EQU CYREG_SCB1_INTR_S_MASK
UART_PC_SCB__INTR_S_MASKED EQU CYREG_SCB1_INTR_S_MASKED
UART_PC_SCB__INTR_S_SET EQU CYREG_SCB1_INTR_S_SET
UART_PC_SCB__INTR_SPI_EC EQU CYREG_SCB1_INTR_SPI_EC
UART_PC_SCB__INTR_SPI_EC_MASK EQU CYREG_SCB1_INTR_SPI_EC_MASK
UART_PC_SCB__INTR_SPI_EC_MASKED EQU CYREG_SCB1_INTR_SPI_EC_MASKED
UART_PC_SCB__INTR_TX EQU CYREG_SCB1_INTR_TX
UART_PC_SCB__INTR_TX_MASK EQU CYREG_SCB1_INTR_TX_MASK
UART_PC_SCB__INTR_TX_MASKED EQU CYREG_SCB1_INTR_TX_MASKED
UART_PC_SCB__INTR_TX_SET EQU CYREG_SCB1_INTR_TX_SET
UART_PC_SCB__RX_CTRL EQU CYREG_SCB1_RX_CTRL
UART_PC_SCB__RX_FIFO_CTRL EQU CYREG_SCB1_RX_FIFO_CTRL
UART_PC_SCB__RX_FIFO_RD EQU CYREG_SCB1_RX_FIFO_RD
UART_PC_SCB__RX_FIFO_RD_SILENT EQU CYREG_SCB1_RX_FIFO_RD_SILENT
UART_PC_SCB__RX_FIFO_STATUS EQU CYREG_SCB1_RX_FIFO_STATUS
UART_PC_SCB__RX_MATCH EQU CYREG_SCB1_RX_MATCH
UART_PC_SCB__SPI_CTRL EQU CYREG_SCB1_SPI_CTRL
UART_PC_SCB__SPI_STATUS EQU CYREG_SCB1_SPI_STATUS
UART_PC_SCB__SS0_POSISTION EQU 0
UART_PC_SCB__SS1_POSISTION EQU 1
UART_PC_SCB__SS2_POSISTION EQU 2
UART_PC_SCB__SS3_POSISTION EQU 3
UART_PC_SCB__STATUS EQU CYREG_SCB1_STATUS
UART_PC_SCB__TX_CTRL EQU CYREG_SCB1_TX_CTRL
UART_PC_SCB__TX_FIFO_CTRL EQU CYREG_SCB1_TX_FIFO_CTRL
UART_PC_SCB__TX_FIFO_STATUS EQU CYREG_SCB1_TX_FIFO_STATUS
UART_PC_SCB__TX_FIFO_WR EQU CYREG_SCB1_TX_FIFO_WR
UART_PC_SCB__UART_CTRL EQU CYREG_SCB1_UART_CTRL
UART_PC_SCB__UART_FLOW_CTRL EQU CYREG_SCB1_UART_FLOW_CTRL
UART_PC_SCB__UART_RX_CTRL EQU CYREG_SCB1_UART_RX_CTRL
UART_PC_SCB__UART_RX_STATUS EQU CYREG_SCB1_UART_RX_STATUS
UART_PC_SCB__UART_TX_CTRL EQU CYREG_SCB1_UART_TX_CTRL
UART_PC_SCB_IRQ__INTC_CLR_EN_REG EQU CYREG_CM0P_ICER
UART_PC_SCB_IRQ__INTC_CLR_PD_REG EQU CYREG_CM0P_ICPR
UART_PC_SCB_IRQ__INTC_MASK EQU 0x200
UART_PC_SCB_IRQ__INTC_NUMBER EQU 9
UART_PC_SCB_IRQ__INTC_PRIOR_MASK EQU 0xC000
UART_PC_SCB_IRQ__INTC_PRIOR_NUM EQU 3
UART_PC_SCB_IRQ__INTC_PRIOR_REG EQU CYREG_CM0P_IPR2
UART_PC_SCB_IRQ__INTC_SET_EN_REG EQU CYREG_CM0P_ISER
UART_PC_SCB_IRQ__INTC_SET_PD_REG EQU CYREG_CM0P_ISPR
UART_PC_SCBCLK__CTRL_REGISTER EQU CYREG_PERI_PCLK_CTL1
UART_PC_SCBCLK__DIV_ID EQU 0x00000042
UART_PC_SCBCLK__DIV_REGISTER EQU CYREG_PERI_DIV_16_CTL2
UART_PC_SCBCLK__PA_DIV_ID EQU 0x000000FF
UART_PC_tx__0__DR EQU CYREG_GPIO_PRT0_DR
UART_PC_tx__0__DR_CLR EQU CYREG_GPIO_PRT0_DR_CLR
UART_PC_tx__0__DR_INV EQU CYREG_GPIO_PRT0_DR_INV
UART_PC_tx__0__DR_SET EQU CYREG_GPIO_PRT0_DR_SET
UART_PC_tx__0__HSIOM EQU CYREG_HSIOM_PORT_SEL0
UART_PC_tx__0__HSIOM_GPIO EQU 0
UART_PC_tx__0__HSIOM_I2C EQU 14
UART_PC_tx__0__HSIOM_I2C_SDA EQU 14
UART_PC_tx__0__HSIOM_MASK EQU 0x00F00000
UART_PC_tx__0__HSIOM_SHIFT EQU 20
UART_PC_tx__0__HSIOM_SPI EQU 15
UART_PC_tx__0__HSIOM_SPI_MISO EQU 15
UART_PC_tx__0__HSIOM_UART EQU 9
UART_PC_tx__0__HSIOM_UART_TX EQU 9
UART_PC_tx__0__INTCFG EQU CYREG_GPIO_PRT0_INTR_CFG
UART_PC_tx__0__INTR EQU CYREG_GPIO_PRT0_INTR
UART_PC_tx__0__INTR_CFG EQU CYREG_GPIO_PRT0_INTR_CFG
UART_PC_tx__0__INTSTAT EQU CYREG_GPIO_PRT0_INTR
UART_PC_tx__0__MASK EQU 0x20
UART_PC_tx__0__PC EQU CYREG_GPIO_PRT0_PC
UART_PC_tx__0__PC2 EQU CYREG_GPIO_PRT0_PC2
UART_PC_tx__0__PORT EQU 0
UART_PC_tx__0__PS EQU CYREG_GPIO_PRT0_PS
UART_PC_tx__0__SHIFT EQU 5
UART_PC_tx__DR EQU CYREG_GPIO_PRT0_DR
UART_PC_tx__DR_CLR EQU CYREG_GPIO_PRT0_DR_CLR
UART_PC_tx__DR_INV EQU CYREG_GPIO_PRT0_DR_INV
UART_PC_tx__DR_SET EQU CYREG_GPIO_PRT0_DR_SET
UART_PC_tx__INTCFG EQU CYREG_GPIO_PRT0_INTR_CFG
UART_PC_tx__INTR EQU CYREG_GPIO_PRT0_INTR
UART_PC_tx__INTR_CFG EQU CYREG_GPIO_PRT0_INTR_CFG
UART_PC_tx__INTSTAT EQU CYREG_GPIO_PRT0_INTR
UART_PC_tx__MASK EQU 0x20
UART_PC_tx__PC EQU CYREG_GPIO_PRT0_PC
UART_PC_tx__PC2 EQU CYREG_GPIO_PRT0_PC2
UART_PC_tx__PORT EQU 0
UART_PC_tx__PS EQU CYREG_GPIO_PRT0_PS
UART_PC_tx__SHIFT EQU 5

; ADC_Temp
ADC_Temp_Bypass__0__DR EQU CYREG_GPIO_PRT2_DR
ADC_Temp_Bypass__0__DR_CLR EQU CYREG_GPIO_PRT2_DR_CLR
ADC_Temp_Bypass__0__DR_INV EQU CYREG_GPIO_PRT2_DR_INV
ADC_Temp_Bypass__0__DR_SET EQU CYREG_GPIO_PRT2_DR_SET
ADC_Temp_Bypass__0__HSIOM EQU CYREG_HSIOM_PORT_SEL2
ADC_Temp_Bypass__0__HSIOM_MASK EQU 0xF0000000
ADC_Temp_Bypass__0__HSIOM_SHIFT EQU 28
ADC_Temp_Bypass__0__INTCFG EQU CYREG_GPIO_PRT2_INTR_CFG
ADC_Temp_Bypass__0__INTR EQU CYREG_GPIO_PRT2_INTR
ADC_Temp_Bypass__0__INTR_CFG EQU CYREG_GPIO_PRT2_INTR_CFG
ADC_Temp_Bypass__0__INTSTAT EQU CYREG_GPIO_PRT2_INTR
ADC_Temp_Bypass__0__MASK EQU 0x80
ADC_Temp_Bypass__0__PC EQU CYREG_GPIO_PRT2_PC
ADC_Temp_Bypass__0__PC2 EQU CYREG_GPIO_PRT2_PC2
ADC_Temp_Bypass__0__PORT EQU 2
ADC_Temp_Bypass__0__PS EQU CYREG_GPIO_PRT2_PS
ADC_Temp_Bypass__0__SHIFT EQU 7
ADC_Temp_Bypass__DR EQU CYREG_GPIO_PRT2_DR
ADC_Temp_Bypass__DR_CLR EQU CYREG_GPIO_PRT2_DR_CLR
ADC_Temp_Bypass__DR_INV EQU CYREG_GPIO_PRT2_DR_INV
ADC_Temp_Bypass__DR_SET EQU CYREG_GPIO_PRT2_DR_SET
ADC_Temp_Bypass__INTCFG EQU CYREG_GPIO_PRT2_INTR_CFG
ADC_Temp_Bypass__INTR EQU CYREG_GPIO_PRT2_INTR
ADC_Temp_Bypass__INTR_CFG EQU CYREG_GPIO_PRT2_INTR_CFG
ADC_Temp_Bypass__INTSTAT EQU CYREG_GPIO_PRT2_INTR
ADC_Temp_Bypass__MASK EQU 0x80
ADC_Temp_Bypass__PC EQU CYREG_GPIO_PRT2_PC
ADC_Temp_Bypass__PC2 EQU CYREG_GPIO_PRT2_PC2
ADC_Temp_Bypass__PORT EQU 2
ADC_Temp_Bypass__PS EQU CYREG_GPIO_PRT2_PS
ADC_Temp_Bypass__SHIFT EQU 7
ADC_Temp_cy_psoc4_sar_1__CLOCK_DIV_ID EQU 0x00000041
ADC_Temp_cy_psoc4_sar_1__SAR_ANA_TRIM EQU CYREG_SAR_ANA_TRIM
ADC_Temp_cy_psoc4_sar_1__SAR_AVG_STAT EQU CYREG_SAR_AVG_STAT
ADC_Temp_cy_psoc4_sar_1__SAR_CHAN_CONFIG00 EQU CYREG_SAR_CHAN_CONFIG0
ADC_Temp_cy_psoc4_sar_1__SAR_CHAN_CONFIG01 EQU CYREG_SAR_CHAN_CONFIG1
ADC_Temp_cy_psoc4_sar_1__SAR_CHAN_CONFIG02 EQU CYREG_SAR_CHAN_CONFIG2
ADC_Temp_cy_psoc4_sar_1__SAR_CHAN_CONFIG03 EQU CYREG_SAR_CHAN_CONFIG3
ADC_Temp_cy_psoc4_sar_1__SAR_CHAN_CONFIG04 EQU CYREG_SAR_CHAN_CONFIG4
ADC_Temp_cy_psoc4_sar_1__SAR_CHAN_CONFIG05 EQU CYREG_SAR_CHAN_CONFIG5
ADC_Temp_cy_psoc4_sar_1__SAR_CHAN_CONFIG06 EQU CYREG_SAR_CHAN_CONFIG6
ADC_Temp_cy_psoc4_sar_1__SAR_CHAN_CONFIG07 EQU CYREG_SAR_CHAN_CONFIG7
ADC_Temp_cy_psoc4_sar_1__SAR_CHAN_CONFIG08 EQU CYREG_SAR_CHAN_CONFIG8
ADC_Temp_cy_psoc4_sar_1__SAR_CHAN_CONFIG09 EQU CYREG_SAR_CHAN_CONFIG9
ADC_Temp_cy_psoc4_sar_1__SAR_CHAN_CONFIG10 EQU CYREG_SAR_CHAN_CONFIG10
ADC_Temp_cy_psoc4_sar_1__SAR_CHAN_CONFIG11 EQU CYREG_SAR_CHAN_CONFIG11
ADC_Temp_cy_psoc4_sar_1__SAR_CHAN_CONFIG12 EQU CYREG_SAR_CHAN_CONFIG12
ADC_Temp_cy_psoc4_sar_1__SAR_CHAN_CONFIG13 EQU CYREG_SAR_CHAN_CONFIG13
ADC_Temp_cy_psoc4_sar_1__SAR_CHAN_CONFIG14 EQU CYREG_SAR_CHAN_CONFIG14
ADC_Temp_cy_psoc4_sar_1__SAR_CHAN_CONFIG15 EQU CYREG_SAR_CHAN_CONFIG15
ADC_Temp_cy_psoc4_sar_1__SAR_CHAN_EN EQU CYREG_SAR_CHAN_EN
ADC_Temp_cy_psoc4_sar_1__SAR_CHAN_RESULT_NEWVALUE EQU CYREG_SAR_CHAN_RESULT_NEWVALUE
ADC_Temp_cy_psoc4_sar_1__SAR_CHAN_RESULT_UPDATED EQU CYREG_SAR_CHAN_RESULT_UPDATED
ADC_Temp_cy_psoc4_sar_1__SAR_CHAN_RESULT00 EQU CYREG_SAR_CHAN_RESULT0
ADC_Temp_cy_psoc4_sar_1__SAR_CHAN_RESULT01 EQU CYREG_SAR_CHAN_RESULT1
ADC_Temp_cy_psoc4_sar_1__SAR_CHAN_RESULT02 EQU CYREG_SAR_CHAN_RESULT2
ADC_Temp_cy_psoc4_sar_1__SAR_CHAN_RESULT03 EQU CYREG_SAR_CHAN_RESULT3
ADC_Temp_cy_psoc4_sar_1__SAR_CHAN_RESULT04 EQU CYREG_SAR_CHAN_RESULT4
ADC_Temp_cy_psoc4_sar_1__SAR_CHAN_RESULT05 EQU CYREG_SAR_CHAN_RESULT5
ADC_Temp_cy_psoc4_sar_1__SAR_CHAN_RESULT06 EQU CYREG_SAR_CHAN_RESULT6
ADC_Temp_cy_psoc4_sar_1__SAR_CHAN_RESULT07 EQU CYREG_SAR_CHAN_RESULT7
ADC_Temp_cy_psoc4_sar_1__SAR_CHAN_RESULT08 EQU CYREG_SAR_CHAN_RESULT8
ADC_Temp_cy_psoc4_sar_1__SAR_CHAN_RESULT09 EQU CYREG_SAR_CHAN_RESULT9
ADC_Temp_cy_psoc4_sar_1__SAR_CHAN_RESULT10 EQU CYREG_SAR_CHAN_RESULT10
ADC_Temp_cy_psoc4_sar_1__SAR_CHAN_RESULT11 EQU CYREG_SAR_CHAN_RESULT11
ADC_Temp_cy_psoc4_sar_1__SAR_CHAN_RESULT12 EQU CYREG_SAR_CHAN_RESULT12
ADC_Temp_cy_psoc4_sar_1__SAR_CHAN_RESULT13 EQU CYREG_SAR_CHAN_RESULT13
ADC_Temp_cy_psoc4_sar_1__SAR_CHAN_RESULT14 EQU CYREG_SAR_CHAN_RESULT14
ADC_Temp_cy_psoc4_sar_1__SAR_CHAN_RESULT15 EQU CYREG_SAR_CHAN_RESULT15
ADC_Temp_cy_psoc4_sar_1__SAR_CHAN_WORK_NEWVALUE EQU CYREG_SAR_CHAN_WORK_NEWVALUE
ADC_Temp_cy_psoc4_sar_1__SAR_CHAN_WORK_UPDATED EQU CYREG_SAR_CHAN_WORK_UPDATED
ADC_Temp_cy_psoc4_sar_1__SAR_CHAN_WORK00 EQU CYREG_SAR_CHAN_WORK0
ADC_Temp_cy_psoc4_sar_1__SAR_CHAN_WORK01 EQU CYREG_SAR_CHAN_WORK1
ADC_Temp_cy_psoc4_sar_1__SAR_CHAN_WORK02 EQU CYREG_SAR_CHAN_WORK2
ADC_Temp_cy_psoc4_sar_1__SAR_CHAN_WORK03 EQU CYREG_SAR_CHAN_WORK3
ADC_Temp_cy_psoc4_sar_1__SAR_CHAN_WORK04 EQU CYREG_SAR_CHAN_WORK4
ADC_Temp_cy_psoc4_sar_1__SAR_CHAN_WORK05 EQU CYREG_SAR_CHAN_WORK5
ADC_Temp_cy_psoc4_sar_1__SAR_CHAN_WORK06 EQU CYREG_SAR_CHAN_WORK6
ADC_Temp_cy_psoc4_sar_1__SAR_CHAN_WORK07 EQU CYREG_SAR_CHAN_WORK7
ADC_Temp_cy_psoc4_sar_1__SAR_CHAN_WORK08 EQU CYREG_SAR_CHAN_WORK8
ADC_Temp_cy_psoc4_sar_1__SAR_CHAN_WORK09 EQU CYREG_SAR_CHAN_WORK9
ADC_Temp_cy_psoc4_sar_1__SAR_CHAN_WORK10 EQU CYREG_SAR_CHAN_WORK10
ADC_Temp_cy_psoc4_sar_1__SAR_CHAN_WORK11 EQU CYREG_SAR_CHAN_WORK11
ADC_Temp_cy_psoc4_sar_1__SAR_CHAN_WORK12 EQU CYREG_SAR_CHAN_WORK12
ADC_Temp_cy_psoc4_sar_1__SAR_CHAN_WORK13 EQU CYREG_SAR_CHAN_WORK13
ADC_Temp_cy_psoc4_sar_1__SAR_CHAN_WORK14 EQU CYREG_SAR_CHAN_WORK14
ADC_Temp_cy_psoc4_sar_1__SAR_CHAN_WORK15 EQU CYREG_SAR_CHAN_WORK15
ADC_Temp_cy_psoc4_sar_1__SAR_CTRL EQU CYREG_SAR_CTRL
ADC_Temp_cy_psoc4_sar_1__SAR_DFT_CTRL EQU CYREG_SAR_DFT_CTRL
ADC_Temp_cy_psoc4_sar_1__SAR_INTR EQU CYREG_SAR_INTR
ADC_Temp_cy_psoc4_sar_1__SAR_INTR_CAUSE EQU CYREG_SAR_INTR_CAUSE
ADC_Temp_cy_psoc4_sar_1__SAR_INTR_MASK EQU CYREG_SAR_INTR_MASK
ADC_Temp_cy_psoc4_sar_1__SAR_INTR_MASKED EQU CYREG_SAR_INTR_MASKED
ADC_Temp_cy_psoc4_sar_1__SAR_INTR_SET EQU CYREG_SAR_INTR_SET
ADC_Temp_cy_psoc4_sar_1__SAR_MUX_SWITCH_CLEAR0 EQU CYREG_SAR_MUX_SWITCH_CLEAR0
ADC_Temp_cy_psoc4_sar_1__SAR_MUX_SWITCH_CLEAR1 EQU CYREG_SAR_MUX_SWITCH_CLEAR1
ADC_Temp_cy_psoc4_sar_1__SAR_MUX_SWITCH_HW_CTRL EQU CYREG_SAR_MUX_SWITCH_HW_CTRL
ADC_Temp_cy_psoc4_sar_1__SAR_MUX_SWITCH_STATUS EQU CYREG_SAR_MUX_SWITCH_STATUS
ADC_Temp_cy_psoc4_sar_1__SAR_MUX_SWITCH0 EQU CYREG_SAR_MUX_SWITCH0
ADC_Temp_cy_psoc4_sar_1__SAR_MUX_SWITCH1 EQU CYREG_SAR_MUX_SWITCH1
ADC_Temp_cy_psoc4_sar_1__SAR_NUMBER EQU 0
ADC_Temp_cy_psoc4_sar_1__SAR_PUMP_CTRL EQU CYREG_SAR_PUMP_CTRL
ADC_Temp_cy_psoc4_sar_1__SAR_RANGE_COND EQU CYREG_SAR_RANGE_COND
ADC_Temp_cy_psoc4_sar_1__SAR_RANGE_INTR EQU CYREG_SAR_RANGE_INTR
ADC_Temp_cy_psoc4_sar_1__SAR_RANGE_INTR_MASK EQU CYREG_SAR_RANGE_INTR_MASK
ADC_Temp_cy_psoc4_sar_1__SAR_RANGE_INTR_MASKED EQU CYREG_SAR_RANGE_INTR_MASKED
ADC_Temp_cy_psoc4_sar_1__SAR_RANGE_INTR_SET EQU CYREG_SAR_RANGE_INTR_SET
ADC_Temp_cy_psoc4_sar_1__SAR_RANGE_THRES EQU CYREG_SAR_RANGE_THRES
ADC_Temp_cy_psoc4_sar_1__SAR_SAMPLE_CTRL EQU CYREG_SAR_SAMPLE_CTRL
ADC_Temp_cy_psoc4_sar_1__SAR_SAMPLE_TIME01 EQU CYREG_SAR_SAMPLE_TIME01
ADC_Temp_cy_psoc4_sar_1__SAR_SAMPLE_TIME23 EQU CYREG_SAR_SAMPLE_TIME23
ADC_Temp_cy_psoc4_sar_1__SAR_SATURATE_INTR EQU CYREG_SAR_SATURATE_INTR
ADC_Temp_cy_psoc4_sar_1__SAR_SATURATE_INTR_MASK EQU CYREG_SAR_SATURATE_INTR_MASK
ADC_Temp_cy_psoc4_sar_1__SAR_SATURATE_INTR_MASKED EQU CYREG_SAR_SATURATE_INTR_MASKED
ADC_Temp_cy_psoc4_sar_1__SAR_SATURATE_INTR_SET EQU CYREG_SAR_SATURATE_INTR_SET
ADC_Temp_cy_psoc4_sar_1__SAR_START_CTRL EQU CYREG_SAR_START_CTRL
ADC_Temp_cy_psoc4_sar_1__SAR_STATUS EQU CYREG_SAR_STATUS
ADC_Temp_cy_psoc4_sar_1__SAR_WOUNDING EQU CYREG_SAR_WOUNDING
ADC_Temp_intSarClock__CTRL_REGISTER EQU CYREG_PERI_PCLK_CTL12
ADC_Temp_intSarClock__DIV_ID EQU 0x00000041
ADC_Temp_intSarClock__DIV_REGISTER EQU CYREG_PERI_DIV_16_CTL1
ADC_Temp_intSarClock__PA_DIV_ID EQU 0x000000FF
ADC_Temp_intUabClock__DIV_ID EQU 0x00000040
ADC_Temp_intUabClock__DIV_REGISTER EQU CYREG_PERI_DIV_16_CTL0
ADC_Temp_intUabClock__PA_DIV_ID EQU 0x000000FF
ADC_Temp_IRQ__INTC_CLR_EN_REG EQU CYREG_CM0P_ICER
ADC_Temp_IRQ__INTC_CLR_PD_REG EQU CYREG_CM0P_ICPR
ADC_Temp_IRQ__INTC_MASK EQU 0x8000
ADC_Temp_IRQ__INTC_NUMBER EQU 15
ADC_Temp_IRQ__INTC_PRIOR_MASK EQU 0xC0000000
ADC_Temp_IRQ__INTC_PRIOR_NUM EQU 3
ADC_Temp_IRQ__INTC_PRIOR_REG EQU CYREG_CM0P_IPR3
ADC_Temp_IRQ__INTC_SET_EN_REG EQU CYREG_CM0P_ISER
ADC_Temp_IRQ__INTC_SET_PD_REG EQU CYREG_CM0P_ISPR

; Thermocouple_Input_P
Thermocouple_Input_P__0__DR EQU CYREG_GPIO_PRT3_DR
Thermocouple_Input_P__0__DR_CLR EQU CYREG_GPIO_PRT3_DR_CLR
Thermocouple_Input_P__0__DR_INV EQU CYREG_GPIO_PRT3_DR_INV
Thermocouple_Input_P__0__DR_SET EQU CYREG_GPIO_PRT3_DR_SET
Thermocouple_Input_P__0__HSIOM EQU CYREG_HSIOM_PORT_SEL3
Thermocouple_Input_P__0__HSIOM_MASK EQU 0x00000F00
Thermocouple_Input_P__0__HSIOM_SHIFT EQU 8
Thermocouple_Input_P__0__INTCFG EQU CYREG_GPIO_PRT3_INTR_CFG
Thermocouple_Input_P__0__INTR EQU CYREG_GPIO_PRT3_INTR
Thermocouple_Input_P__0__INTR_CFG EQU CYREG_GPIO_PRT3_INTR_CFG
Thermocouple_Input_P__0__INTSTAT EQU CYREG_GPIO_PRT3_INTR
Thermocouple_Input_P__0__MASK EQU 0x04
Thermocouple_Input_P__0__PC EQU CYREG_GPIO_PRT3_PC
Thermocouple_Input_P__0__PC2 EQU CYREG_GPIO_PRT3_PC2
Thermocouple_Input_P__0__PORT EQU 3
Thermocouple_Input_P__0__PS EQU CYREG_GPIO_PRT3_PS
Thermocouple_Input_P__0__SHIFT EQU 2
Thermocouple_Input_P__DR EQU CYREG_GPIO_PRT3_DR
Thermocouple_Input_P__DR_CLR EQU CYREG_GPIO_PRT3_DR_CLR
Thermocouple_Input_P__DR_INV EQU CYREG_GPIO_PRT3_DR_INV
Thermocouple_Input_P__DR_SET EQU CYREG_GPIO_PRT3_DR_SET
Thermocouple_Input_P__INTCFG EQU CYREG_GPIO_PRT3_INTR_CFG
Thermocouple_Input_P__INTR EQU CYREG_GPIO_PRT3_INTR
Thermocouple_Input_P__INTR_CFG EQU CYREG_GPIO_PRT3_INTR_CFG
Thermocouple_Input_P__INTSTAT EQU CYREG_GPIO_PRT3_INTR
Thermocouple_Input_P__MASK EQU 0x04
Thermocouple_Input_P__PC EQU CYREG_GPIO_PRT3_PC
Thermocouple_Input_P__PC2 EQU CYREG_GPIO_PRT3_PC2
Thermocouple_Input_P__PORT EQU 3
Thermocouple_Input_P__PS EQU CYREG_GPIO_PRT3_PS
Thermocouple_Input_P__SHIFT EQU 2

; Miscellaneous
CyDesignWideVoltageReference_PRB_REF EQU CYREG_PASS_PRB_REF0
CYDEV_BANDGAP_REF_GAIN EQU 1
CYDEV_BCLK__HFCLK__HZ EQU 24000000
CYDEV_BCLK__HFCLK__KHZ EQU 24000
CYDEV_BCLK__HFCLK__MHZ EQU 24
CYDEV_BCLK__SYSCLK__HZ EQU 24000000
CYDEV_BCLK__SYSCLK__KHZ EQU 24000
CYDEV_BCLK__SYSCLK__MHZ EQU 24
CYDEV_CHIP_DIE_LEOPARD EQU 1
CYDEV_CHIP_DIE_PSOC4A EQU 24
CYDEV_CHIP_DIE_PSOC5LP EQU 2
CYDEV_CHIP_DIE_PSOC5TM EQU 3
CYDEV_CHIP_DIE_TMA4 EQU 4
CYDEV_CHIP_DIE_UNKNOWN EQU 0
CYDEV_CHIP_FAMILY_FM0P EQU 5
CYDEV_CHIP_FAMILY_FM3 EQU 6
CYDEV_CHIP_FAMILY_FM4 EQU 7
CYDEV_CHIP_FAMILY_PSOC3 EQU 1
CYDEV_CHIP_FAMILY_PSOC4 EQU 2
CYDEV_CHIP_FAMILY_PSOC5 EQU 3
CYDEV_CHIP_FAMILY_PSOC6 EQU 4
CYDEV_CHIP_FAMILY_UNKNOWN EQU 0
CYDEV_CHIP_FAMILY_USED EQU CYDEV_CHIP_FAMILY_PSOC4
CYDEV_CHIP_JTAG_ID EQU 0x1C2021AC
CYDEV_CHIP_MEMBER_3A EQU 1
CYDEV_CHIP_MEMBER_4A EQU 24
CYDEV_CHIP_MEMBER_4AA EQU 23
CYDEV_CHIP_MEMBER_4AB EQU 28
CYDEV_CHIP_MEMBER_4AC EQU 14
CYDEV_CHIP_MEMBER_4D EQU 18
CYDEV_CHIP_MEMBER_4E EQU 6
CYDEV_CHIP_MEMBER_4F EQU 25
CYDEV_CHIP_MEMBER_4G EQU 4
CYDEV_CHIP_MEMBER_4H EQU 22
CYDEV_CHIP_MEMBER_4I EQU 30
CYDEV_CHIP_MEMBER_4J EQU 19
CYDEV_CHIP_MEMBER_4K EQU 20
CYDEV_CHIP_MEMBER_4L EQU 29
CYDEV_CHIP_MEMBER_4M EQU 27
CYDEV_CHIP_MEMBER_4N EQU 11
CYDEV_CHIP_MEMBER_4O EQU 8
CYDEV_CHIP_MEMBER_4P EQU 26
CYDEV_CHIP_MEMBER_4Q EQU 15
CYDEV_CHIP_MEMBER_4R EQU 9
CYDEV_CHIP_MEMBER_4S EQU 12
CYDEV_CHIP_MEMBER_4T EQU 10
CYDEV_CHIP_MEMBER_4U EQU 5
CYDEV_CHIP_MEMBER_4V EQU 21
CYDEV_CHIP_MEMBER_4W EQU 13
CYDEV_CHIP_MEMBER_4X EQU 7
CYDEV_CHIP_MEMBER_4Y EQU 16
CYDEV_CHIP_MEMBER_4Z EQU 17
CYDEV_CHIP_MEMBER_5A EQU 3
CYDEV_CHIP_MEMBER_5B EQU 2
CYDEV_CHIP_MEMBER_6A EQU 31
CYDEV_CHIP_MEMBER_FM3 EQU 35
CYDEV_CHIP_MEMBER_FM4 EQU 36
CYDEV_CHIP_MEMBER_PDL_FM0P_TYPE1 EQU 32
CYDEV_CHIP_MEMBER_PDL_FM0P_TYPE2 EQU 33
CYDEV_CHIP_MEMBER_PDL_FM0P_TYPE3 EQU 34
CYDEV_CHIP_MEMBER_UNKNOWN EQU 0
CYDEV_CHIP_MEMBER_USED EQU CYDEV_CHIP_MEMBER_4I
CYDEV_CHIP_DIE_EXPECT EQU CYDEV_CHIP_MEMBER_USED
CYDEV_CHIP_DIE_ACTUAL EQU CYDEV_CHIP_DIE_EXPECT
CYDEV_CHIP_REV_LEOPARD_ES1 EQU 0
CYDEV_CHIP_REV_LEOPARD_ES2 EQU 1
CYDEV_CHIP_REV_LEOPARD_ES3 EQU 3
CYDEV_CHIP_REV_LEOPARD_PRODUCTION EQU 3
CYDEV_CHIP_REV_PSOC4A_ES0 EQU 17
CYDEV_CHIP_REV_PSOC4A_PRODUCTION EQU 17
CYDEV_CHIP_REV_PSOC5LP_ES0 EQU 0
CYDEV_CHIP_REV_PSOC5LP_PRODUCTION EQU 0
CYDEV_CHIP_REV_PSOC5TM_ES0 EQU 0
CYDEV_CHIP_REV_PSOC5TM_ES1 EQU 1
CYDEV_CHIP_REV_PSOC5TM_PRODUCTION EQU 1
CYDEV_CHIP_REV_TMA4_ES EQU 17
CYDEV_CHIP_REV_TMA4_ES2 EQU 33
CYDEV_CHIP_REV_TMA4_PRODUCTION EQU 17
CYDEV_CHIP_REVISION_3A_ES1 EQU 0
CYDEV_CHIP_REVISION_3A_ES2 EQU 1
CYDEV_CHIP_REVISION_3A_ES3 EQU 3
CYDEV_CHIP_REVISION_3A_PRODUCTION EQU 3
CYDEV_CHIP_REVISION_4A_ES0 EQU 17
CYDEV_CHIP_REVISION_4A_PRODUCTION EQU 17
CYDEV_CHIP_REVISION_4AA_PRODUCTION EQU 0
CYDEV_CHIP_REVISION_4AB_PRODUCTION EQU 0
CYDEV_CHIP_REVISION_4AC_PRODUCTION EQU 0
CYDEV_CHIP_REVISION_4D_PRODUCTION EQU 0
CYDEV_CHIP_REVISION_4E_CCG2_NO_USBPD EQU 0
CYDEV_CHIP_REVISION_4E_PRODUCTION EQU 0
CYDEV_CHIP_REVISION_4F_PRODUCTION EQU 0
CYDEV_CHIP_REVISION_4F_PRODUCTION_256DMA EQU 0
CYDEV_CHIP_REVISION_4F_PRODUCTION_256K EQU 0
CYDEV_CHIP_REVISION_4G_ES EQU 17
CYDEV_CHIP_REVISION_4G_ES2 EQU 33
CYDEV_CHIP_REVISION_4G_PRODUCTION EQU 17
CYDEV_CHIP_REVISION_4H_PRODUCTION EQU 0
CYDEV_CHIP_REVISION_4I_PRODUCTION EQU 0
CYDEV_CHIP_REVISION_4J_PRODUCTION EQU 0
CYDEV_CHIP_REVISION_4K_PRODUCTION EQU 0
CYDEV_CHIP_REVISION_4L_PRODUCTION EQU 0
CYDEV_CHIP_REVISION_4M_PRODUCTION EQU 0
CYDEV_CHIP_REVISION_4N_PRODUCTION EQU 0
CYDEV_CHIP_REVISION_4O_PRODUCTION EQU 0
CYDEV_CHIP_REVISION_4P_PRODUCTION EQU 0
CYDEV_CHIP_REVISION_4Q_PRODUCTION EQU 0
CYDEV_CHIP_REVISION_4R_PRODUCTION EQU 0
CYDEV_CHIP_REVISION_4S_PRODUCTION EQU 0
CYDEV_CHIP_REVISION_4T_PRODUCTION EQU 0
CYDEV_CHIP_REVISION_4U_PRODUCTION EQU 0
CYDEV_CHIP_REVISION_4V_PRODUCTION EQU 0
CYDEV_CHIP_REVISION_4W_PRODUCTION EQU 0
CYDEV_CHIP_REVISION_4X_PRODUCTION EQU 0
CYDEV_CHIP_REVISION_4Y_PRODUCTION EQU 0
CYDEV_CHIP_REVISION_4Z_PRODUCTION EQU 0
CYDEV_CHIP_REVISION_5A_ES0 EQU 0
CYDEV_CHIP_REVISION_5A_ES1 EQU 1
CYDEV_CHIP_REVISION_5A_PRODUCTION EQU 1
CYDEV_CHIP_REVISION_5B_ES0 EQU 0
CYDEV_CHIP_REVISION_5B_PRODUCTION EQU 0
CYDEV_CHIP_REVISION_6A_ES EQU 17
CYDEV_CHIP_REVISION_6A_NO_UDB EQU 33
CYDEV_CHIP_REVISION_6A_PRODUCTION EQU 33
CYDEV_CHIP_REVISION_FM3_PRODUCTION EQU 0
CYDEV_CHIP_REVISION_FM4_PRODUCTION EQU 0
CYDEV_CHIP_REVISION_PDL_FM0P_TYPE1_PRODUCTION EQU 0
CYDEV_CHIP_REVISION_PDL_FM0P_TYPE2_PRODUCTION EQU 0
CYDEV_CHIP_REVISION_PDL_FM0P_TYPE3_PRODUCTION EQU 0
CYDEV_CHIP_REVISION_USED EQU CYDEV_CHIP_REVISION_4I_PRODUCTION
CYDEV_CHIP_REV_EXPECT EQU CYDEV_CHIP_REVISION_USED
CYDEV_CONFIG_READ_ACCELERATOR EQU 1
CYDEV_CONFIG_UNUSED_IO_AllowButWarn EQU 0
CYDEV_CONFIG_UNUSED_IO_AllowWithInfo EQU 1
CYDEV_CONFIG_UNUSED_IO_Disallowed EQU 2
CYDEV_CONFIG_UNUSED_IO EQU CYDEV_CONFIG_UNUSED_IO_Disallowed
CYDEV_CONFIGURATION_COMPRESSED EQU 1
CYDEV_CONFIGURATION_MODE_COMPRESSED EQU 0
CYDEV_CONFIGURATION_MODE EQU CYDEV_CONFIGURATION_MODE_COMPRESSED
CYDEV_CONFIGURATION_MODE_DMA EQU 2
CYDEV_CONFIGURATION_MODE_UNCOMPRESSED EQU 1
CYDEV_DEBUG_PROTECT_KILL EQU 4
CYDEV_DEBUG_PROTECT_OPEN EQU 1
CYDEV_DEBUG_PROTECT EQU CYDEV_DEBUG_PROTECT_OPEN
CYDEV_DEBUG_PROTECT_PROTECTED EQU 2
CYDEV_DEBUGGING_DPS_Disable EQU 3
CYDEV_DEBUGGING_DPS_SWD EQU 2
CYDEV_DEBUGGING_DPS EQU CYDEV_DEBUGGING_DPS_SWD
CYDEV_DEBUGGING_ENABLE EQU 1
CYDEV_DFT_SELECT_CLK0 EQU 8
CYDEV_DFT_SELECT_CLK1 EQU 9
CYDEV_DMA_CHANNELS_AVAILABLE EQU 8
CYDEV_HEAP_SIZE EQU 0x80
CYDEV_IMO_TRIMMED_BY_USB EQU 0
CYDEV_IMO_TRIMMED_BY_WCO EQU 0
CYDEV_INTR_NUMBER_DMA EQU 12
CYDEV_IS_EXPORTING_CODE EQU 0
CYDEV_IS_IMPORTING_CODE EQU 0
CYDEV_PRB_VDDA_SLEEP EQU 0
CYDEV_PROJ_TYPE EQU 0
CYDEV_PROJ_TYPE_BOOTLOADER EQU 1
CYDEV_PROJ_TYPE_LAUNCHER EQU 5
CYDEV_PROJ_TYPE_LOADABLE EQU 2
CYDEV_PROJ_TYPE_LOADABLEANDBOOTLOADER EQU 4
CYDEV_PROJ_TYPE_MULTIAPPBOOTLOADER EQU 3
CYDEV_PROJ_TYPE_STANDARD EQU 0
CYDEV_STACK_SIZE EQU 0x0400
CYDEV_SYSTEM_PRB_SOURCE EQU 0
CYDEV_SYSTEM_PRB_VALUE EQU 15
CYDEV_USE_BUNDLED_CMSIS EQU 1
CYDEV_VARIABLE_VDDA EQU 1
CYDEV_VDDA_MV EQU 3300
CYDEV_VDDD_MV EQU 3300
CYDEV_WDT_GENERATE_ISR EQU 1
CYIPBLOCK_m0s8cpussv3_VERSION EQU 1
CYIPBLOCK_m0s8csdv2_VERSION EQU 2
CYIPBLOCK_m0s8ioss_VERSION EQU 1
CYIPBLOCK_m0s8lcd_VERSION EQU 2
CYIPBLOCK_m0s8lpcomp_VERSION EQU 2
CYIPBLOCK_m0s8pass4b_VERSION EQU 1
CYIPBLOCK_m0s8peri_VERSION EQU 1
CYIPBLOCK_m0s8scb_VERSION EQU 2
CYIPBLOCK_m0s8tcpwm_VERSION EQU 2
CYIPBLOCK_m0s8wco_VERSION EQU 1
CYIPBLOCK_s8srsslt_VERSION EQU 1
DMA_CHANNELS_USED__MASK EQU 0
CYDEV_BOOTLOADER_ENABLE EQU 0
    ENDIF
    END
